# file: POV.ioc
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Dma.Request0=TIM4_UP
Dma.TIM4_UP.0.Direction=DMA_MEMORY_TO_PERIPH
Dma.TIM4_UP.0.Instance=DMA1_Channel7
Dma.TIM4_UP.0.MemDataAlignment=DMA_MDATAALIGN_BYTE
Dma.TIM4_UP.0.MemInc=DMA_MINC_ENABLE
Dma.TIM4_UP.0.Mode=DMA_NORMAL
Dma.TIM4_UP.0.PeriphDataAlignment=DMA_PDATAALIGN_WORD
Dma.TIM4_UP.0.PeriphInc=DMA_PINC_DISABLE
Dma.TIM4_UP.0.Priority=DMA_PRIORITY_HIGH
Mcu.Family=STM32F1
Mcu.Name=STM32F103C(8-B)Tx
Mcu.Package=LQFP48
NVIC.DMA1_Channel7_IRQn=true\:0\:0\:false\:false\:true\:false\:true\:true
NVIC.PriorityGroup=NVIC_PRIORITYGROUP_4
NVIC.TIM2_IRQn=true\:0\:0\:false\:false\:true\:true\:true\:true
PB9.Signal=S_TIM4_CH4
ProjectManager.HeapSize=0x200
ProjectManager.StackSize=0x400
ProjectManager.TargetToolchain=STM32CubeIDE
RCC.AHBFreq_Value=64000000
RCC.APB1CLKDivider=RCC_HCLK_DIV2
RCC.APB1Freq_Value=32000000
RCC.APB1TimFreq_Value=64000000
RCC.APB2Freq_Value=64000000
RCC.APB2TimFreq_Value=64000000
RCC.HCLKFreq_Value=64000000
RCC.PLLMUL=RCC_PLL_MUL16
RCC.SYSCLKFreq_VALUE=64000000
RCC.SYSCLKSource=RCC_SYSCLKSOURCE_PLLCLK
RCC.USBFreq_Value=64000000
SH.S_TIM4_CH4.0=TIM4_CH4,PWM Generation4 CH4
TIM2.Period=999
TIM2.Prescaler=71
TIM4.Channel-PWM\ Generation4\ CH4=TIM_CHANNEL_4
TIM4.Period=89
VP_SYS_VS_ND.Mode=No_Debug
VP_TIM2_VS_ClockSourceINT.Mode=Internal
board=custom

// file: Core/Src/main.c
/* USER CODE BEGIN Header */
/**
  ******************************************************************************
  * @file           : main.c
  * @brief          : Main program body
  ******************************************************************************
  * @attention
  *
  * Copyright (c) 2025 STMicroelectronics.
  * All rights reserved.
  *
  * This software is licensed under terms that can be found in the LICENSE file
  * in the root directory of this software component.
  * If no LICENSE file comes with this software, it is provided AS-IS.
  *
  ******************************************************************************
  */
/* USER CODE END Header */
#include "main.h"
#include "dma.h"
#include "tim.h"
#include "gpio.h"

/* USER CODE BEGIN Includes */
#include "stm32f1xx_hal.h"
#include "stm32f1xx_it.h"
#include "timer.h"
#include "neopixel.h"
#include "dma.h"

/* USER CODE END Includes */

/* USER CODE BEGIN PD */
  NP32_Instance_t np_handle;

/* USER CODE END PD */

void SystemClock_Config(void);

int main(void)
{

  /* MCU Configuration--------------------------------------------------------*/

  /* Reset of all peripherals, Initializes the Flash interface and the Systick. */
  HAL_Init();

  /* USER CODE BEGIN Init */

  __HAL_RCC_GPIOC_CLK_ENABLE();
  GPIO_InitTypeDef GPIO_InitStruct = {0};
  GPIO_InitStruct.Pin = GPIO_PIN_13;          // Pin PC13
  GPIO_InitStruct.Mode = GPIO_MODE_OUTPUT_PP;  // Wyjście push-pull
  GPIO_InitStruct.Pull = GPIO_NOPULL;         // Brak rezystora podciągającego
  GPIO_InitStruct.Speed = GPIO_SPEED_FREQ_LOW; // Niska prędkość przełączania
  HAL_GPIO_Init(GPIOC, &GPIO_InitStruct);     // Inicjalizacja pinu

  /* USER CODE END Init */

  /* Configure the system clock */
  SystemClock_Config();

  /* USER CODE BEGIN SysInit */
  //MX_TIM2_Init(); //inicjacja timera

  //HAL_TIM_Base_Start_IT(&htim2); // start z przerwaniami

  /* USER CODE END SysInit */

  /* Initialize all configured peripherals */
  MX_GPIO_Init();
  MX_DMA_Init();
  MX_TIM2_Init();
  MX_TIM4_Init();
  /* USER CODE BEGIN 2 */
  //HAL_TIM_PWM_Start(&htim4, TIM_CHANNEL_4);
  //init_neopixel();
  POV_TIM_Start(3);

  np_handle.LED_Count = 8;
  np_handle.StartDMA_Call = Start_DMA;
  np_handle.DMA_Busy_Flag = 0;
  np_handle.LED_Disable_Flag = 0;
  NP32_Init(&np_handle);

  // ustawienie koloru tylko raz (np. na start)
  NP32_SetAllLEDs_RGB(&np_handle, (NP32_RGB_t){.R=255, .G=0, .B=0});
  NP32_Update(&np_handle);

  /* USER CODE END 2 */

  /* Infinite loop */
  while (1)
  {

    /* USER CODE BEGIN 3 */

	    /*NP32_RGB_t blue = { .R = 0, .G = 0, .B = 255 };
	    for (int i = 0; i < 4; i++) {
	        NP32_SetLED_RGB(&np_handle, i, blue);
	    }
	    NP32_Update(&np_handle);*/

	    // zmiana okresu w pętli programu
        /*if (HAL_GPIO_ReadPin(BUTTON_GPIO_Port, BUTTON_Pin) == GPIO_PIN_SET) {
            TIM2_Set_Period_ms(2.0f);  // Dynamiczna zmiana okresu!
        }*/
  }
  /* USER CODE END 3 */
}

void SystemClock_Config(void)
{
  RCC_OscInitTypeDef RCC_OscInitStruct = {0};
  RCC_ClkInitTypeDef RCC_ClkInitStruct = {0};

  /** Initializes the RCC Oscillators according to the specified parameters
  * in the RCC_OscInitTypeDef structure.
  */
  RCC_OscInitStruct.OscillatorType = RCC_OSCILLATORTYPE_HSI;
  RCC_OscInitStruct.HSIState = RCC_HSI_ON;
  RCC_OscInitStruct.HSICalibrationValue = RCC_HSICALIBRATION_DEFAULT;
  RCC_OscInitStruct.PLL.PLLState = RCC_PLL_ON;
  RCC_OscInitStruct.PLL.PLLSource = RCC_PLLSOURCE_HSI_DIV2;
  RCC_OscInitStruct.PLL.PLLMUL = RCC_PLL_MUL16;
  if (HAL_RCC_OscConfig(&RCC_OscInitStruct) != HAL_OK)
  {
    Error_Handler();
  }

  /** Initializes the CPU, AHB and APB buses clocks
  */
  RCC_ClkInitStruct.ClockType = RCC_CLOCKTYPE_HCLK|RCC_CLOCKTYPE_SYSCLK
                              |RCC_CLOCKTYPE_PCLK1|RCC_CLOCKTYPE_PCLK2;
  RCC_ClkInitStruct.SYSCLKSource = RCC_SYSCLKSOURCE_PLLCLK;
  RCC_ClkInitStruct.AHBCLKDivider = RCC_SYSCLK_DIV1;
  RCC_ClkInitStruct.APB1CLKDivider = RCC_HCLK_DIV2;
  RCC_ClkInitStruct.APB2CLKDivider = RCC_HCLK_DIV1;

  if (HAL_RCC_ClockConfig(&RCC_ClkInitStruct, FLASH_LATENCY_2) != HAL_OK)
  {
    Error_Handler();
  }
}

void Error_Handler(void)
{
  __disable_irq();
  while (1)
  {
  }
}
